/*******************************************************************************
* 文件名称：LED流水灯实验
* 实验目的：1.掌握单片机IO口操作的基本方法
*           2.掌握移位运算符的使用方法
* 实验配置：J3跳线配置为IO方式，J5配置为KBD、J2配置为1-3和2-4
* 实验现象：LED以0.2S为间隔流水操作
* 硬件环境：IAP15F2K61S2单片机，单片机内部振荡器频率：11.0592M
* 注意事项：要用到_nop_()必须要包含intrins.h头文件
* 日期版本：2022/02/08
*******************************************************************************/

#include "reg52.h"  //定义51单片机特殊功能寄存器
#include "intrins.h"

//关闭外设
void cls_buzz(void)
{
    P2 = (P2 & 0x1F | 0xA0);
    P0 = 0x00;
    P2 &= 0x1F;
}

//延时函数
void delay(void)
{
    unsigned char i, j, k;

    _nop_();
    _nop_();
    i = 9;
    j = 104;
    k = 139;
    do
    {
        do
        {
            while (--k);
        }
        while (--j);
    }
    while (--i);
}

//主函数
void main(void)
{
    unsigned char i;

    cls_buzz();

    while(1)
    {
        for(i = 0; i < 8; i++)
        {
            P2 = ((P2 & 0x1f) | 0x80);
            P0 = ~(0x01 << i); //左移i位，按位取反
            P2 &= 0x1f;
            delay();
        }
    }
}

