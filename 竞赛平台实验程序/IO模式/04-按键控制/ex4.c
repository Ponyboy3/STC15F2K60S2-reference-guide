/*******************************************************************************
* 文件名称：按键控制实验
* 实验目的：1.掌握单片机IO口操作的基本方法
*           2.掌握C51关键字"sbit"的用法
*           2.掌握单片机常见外围驱动电路的设计方法
* 实验配置：J3跳线配置为IO方式，J5配置为BTN
* 实验现象：按s7打开led灯，s6关闭led灯，s5打开蜂鸣器，s4关闭蜂鸣器。
* 硬件环境：IAP15F2K61S2单片机，单片机内部振荡器频率：11.0592M
* 注意事项：包含头文件还可以是STC15F2K60S2.H
* 日期版本：2022/02/08
*******************************************************************************/

#include "reg52.h"  //定义51单片机特殊功能寄存器

/** 独立按键接口 */
sbit S7  = P3 ^ 0;
sbit S6  = P3 ^ 1;
sbit S5  = P3 ^ 2;
sbit S4  = P3 ^ 3;
sbit buzz  = P0 ^ 6;


void cls_buzz(void)
{
    P2 = (P2 & 0x1F | 0xA0);
    P0 = 0x00;
    P2 &= 0x1F;
}

//主函数
void main(void)
{
    cls_buzz();

    while(1)
    {
        if(S7 == 0)
        {
            P2 = ((P2 & 0x1f) | 0x80);
            P0 = 0xff;  //关闭所有LED
            P2 &= 0x1f;
        }
        if(S6 == 0)
        {
            P2 = ((P2 & 0x1f) | 0x80);
            P0 = 0x00;  //打开所有LED
            P2 &= 0x1f;
        }
        if(S5 == 0)
        {
            P2 = ((P2 & 0x1f) | 0xA0);
            P0 = 0x00;
            buzz = 1;	//打开蜂鸣器
            P2 &= 0x1f;
        }
        if(S4 == 0)
        {
            P2 = ((P2 & 0x1f) | 0xA0);
            P0 = 0x00;
            buzz = 0;	//关闭蜂鸣器
            P2 &= 0x1f;
        }
    }
}


